## config/west.yml
```yaml
manifest:
  remotes:
    - name: zmkfirmware
      url-base: https://github.com/zmkfirmware
    - name: janpfischer
      url-base: https://github.com/janpfischer
    - name: JVM3L0
      url-base: https://github.com/JVM3L0
  projects:
    - name: zmk
      remote: zmkfirmware
      revision: main
      import: app/west.yml
    - name: zmk-dongle-screen
      remote: janpfischer
      revision: upgrade-4.1
    - name: prospector-zmk-module
      remote: JVM3L0
      revision: feat/new-status-screens
  self:
    path: config
```
