## boards/shields/flake_dongle/Kconfig.defconfig
```kconfig
if SHIELD_FLAKE_DONGLE

config ZMK_KEYBOARD_NAME
    default "Flake Dongle"

config ZMK_SPLIT
    default y

config ZMK_SPLIT_ROLE_CENTRAL
    default y

# 2 metades = 2 periféricos
config ZMK_SPLIT_BLE_CENTRAL_PERIPHERALS
    default 2

# Perifericos + perfis BT desejados (padrão ZMK é 5)
config BT_MAX_PAIRED
    default 7

config BT_MAX_CONN
    default 7

endif # SHIELD_FLAKE_DONGLE
```
