#include "../anywhy_flake/anywhy_flake.dtsi"

// O dongle não tem matriz física — desliga o kscan real do Flake
&kscan0 {
    status = "disabled";
};

/ {
    // Sobrescreve só o zmk,kscan do chosen (physical-layout continua o do dtsi)
    chosen {
        zmk,kscan = &mock_kscan;
    };

    mock_kscan: mock_kscan_0 {
        compatible = "zmk,kscan-mock";
        columns = <0>;
        rows = <0>;
        events = <0>;
    };
};